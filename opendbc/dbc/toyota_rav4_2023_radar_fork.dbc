VERSION ""

NS_ :

BS_:

BU_: XXX

BO_ 565 RADAR_LEAD_SPEED: 8 XXX
 SG_ REL_SPEED : 31|16@0+ (0.00390625,-128) [-128|127.99] "m/s" XXX

BO_ 567 RADAR_LEAD_DIST: 8 XXX
 SG_ LEAD_DIST : 11|12@0+ (0.05,0) [0|204.75] "m" XXX

CM_ "fork (zfiser): the RAV4 2023 (TSS2, RADAR_ACC) radar lead object on the radar bus (bus 1), 50 Hz. Reverse engineered from 9 min of 2026-11-16 highway recordings against DSU_CRUISE.LEAD_DISTANCE and the camera lead; byte 0 of both messages changes every frame (counter or checksum, not decoded). openpilot has no radar DBC for this car (radarUnavailable).";
CM_ SG_ 565 REL_SPEED "change of LEAD_DIST, positive = the gap opens; matches the slope of LEAD_DIST to 0.08 m/s (r = 1.000)";
CM_ SG_ 567 LEAD_DIST "distance to the radar lead, 0 = no lead; matches DSU_CRUISE.LEAD_DISTANCE (median 0.00 m, 95 % within 1 m) and switches cars about 0.1 s earlier";
